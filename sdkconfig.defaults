## sdkconfig.defaults
```kconfig
# ESP32-S3 baseline
CONFIG_IDF_TARGET="esp32s3"

# USB Host configuration
CONFIG_USB_HOST_CONTROL_TRANSFER_MAX_SIZE=256
CONFIG_USB_OTG_SUPPORTED=y

# Bluetooth configuration
CONFIG_BT_ENABLED=y
CONFIG_BT_BTU_TASK_STACK_SIZE=4096

# Use Bluedroid for HID Device support
CONFIG_BT_BLUEDROID_ENABLED=y
CONFIG_BT_NIMBLE_ENABLED=n

# HID Device support
CONFIG_BT_HID_DEVICE_ENABLED=y

# Standard C++ support for some components
CONFIG_COMPILER_CXX_EXCEPTIONS=y
CONFIG_COMPILER_CXX_RTTI=y

# Console configuration
CONFIG_ESP_CONSOLE_UART_DEFAULT=y
CONFIG_ESP_CONSOLE_USB_CDC=n
CONFIG_ESP_CONSOLE_USB_SERIAL_JTAG=n
CONFIG_ESP_CONSOLE_SECONDARY_NONE=y

# Logging
CONFIG_LOG_DEFAULT_LEVEL_INFO=y
```
